## main/Kconfig.projbuild
```kconfig
menu "Kopter Conifiguration"

    menu "Wi-Fi Configuration"
        menu "SoftAP Configuration"
            comment "SoftAP Configuration"

            config WIFI_AP_SSID
                string "WiFi AP SSID"
                default "esp32-ap"
                help
                    SSID (network name) of the AP.

            config WIFI_AP_PASSWORD
                string "WiFi AP Password"
                default "123"
                help
                    WiFi password of the AP.

            config WIFI_AP_CHANNEL
                int "WiFi AP Channel"
                range 1 14
                default 6
                help
                    WiFi channel (network channel) of the AP.

            config MAX_STA_CONN_AP
                int "Maximal STA connections"
                default 1
                help
                    Max number of the STA connects to AP.
        endmenu

        menu "STA Configuration"
            comment "STA Configuration"

            config WIFI_REMOTE_AP_SSID
                string "WiFi Remote AP SSID"
                default ""
                help
                    SSID (network name) to connect to.

            config WIFI_REMOTE_AP_PASSWORD
                string "WiFi Remote AP Password"
                default ""
                help
                    WiFi password.

            config MAXIMUM_STA_RETRY
                int "Maximum retry"
                default 5
                help
                    Set the maximum retry value to prevent the station from continuously
                    attempting to reconnect to the Access Point (AP) when the AP doesn't exist.

            choice WIFI_SCAN_AUTH_MODE_THRESHOLD
                prompt "WiFi Scan auth mode threshold"
                default WIFI_AUTH_WPA2_PSK
                help
                    The weakest authmode to accept in the scan mode.
                    This value defaults to ESP_WIFI_AUTH_WPA2_PSK in case password is present
                    and ESP_WIFI_AUTH_OPEN is used. Please select ESP_WIFI_AUTH_WEP / ESP_WIFI_AUTH_WPA_PSK
                    in case AP is operating in WEP / WPA mode.

                config WIFI_AUTH_OPEN
                    bool "OPEN"
                config WIFI_AUTH_WEP
                    bool "WEP"
                config WIFI_AUTH_WPA_PSK
                    bool "WPA PSK"
                config WIFI_AUTH_WPA2_PSK
                    bool "WPA2 PSK"
                config WIFI_AUTH_WPA_WPA2_PSK
                    bool "WPA/WPA2 PSK"
                config WIFI_AUTH_WPA3_PSK
                    bool "WPA3 PSK"
                config WIFI_AUTH_WPA2_WPA3_PSK
                    bool "WPA2/WPA3 PSK"
                config WIFI_AUTH_WAPI_PSK
                    bool "WAPI PSK"
            endchoice
        endmenu

        config ENABLE_LONG_RANGE
            bool "Enable Long Range"
            default "n"
            help
                When enable long range, the PHY rate of ESP32 will be 512Kbps or 256Kbps
    endmenu

    menu "OTA Configuration"
        comment "OTA Configuration"
        
        config OTA_ENABLED
            bool "Enable OTA update"
            default "y"
        
        config FIRMWARE_URL
            depends on OTA_ENABLED
            string "Firmware Upgrade URL"
            help
                URL of server which hosts the firmware image.

        config OTA_RECV_TIMEOUT
            depends on OTA_ENABLED
            int "OTA Receive Timeout"
            default 5000
            help
                Maximum time for reception.
    endmenu

    config I2C_SDA_PIN
        int "SDA pin"
        default 21
        help
            SDA pin for communicate by I2C bus.
            
    config I2C_SCL_PIN
        int "SCL pin"
        default 22
        help
            SCL pin for communicate by I2C bus.

    menu "LED configuration"
        config ENABLE_RGB_LED
            bool "Enable RGB LED"
            default "n"
            help
                Allows to use a built-in RGB LED (e.g. WS2812).

        config RGB_LED_PIN
            depends on ENABLE_RGB_LED
            int "RGB LED Pin"
            default 8
            help
               The pin to which the RGB strip is connected.

        config RGB_LED_NUM
            depends on ENABLE_RGB_LED
            int "Number of RGB LED"
            range 1 20
            default 1
            help
               The number of available RGB.
    endmenu


endmenu
```

## sdkconfig.defaults
```kconfig
# Enable C++ exceptions and set emergency pool size for exception objects
CONFIG_COMPILER_CXX_EXCEPTIONS=y
CONFIG_COMPILER_CXX_EXCEPTIONS_EMG_POOL_SIZE=1024
CONFIG_ESP_SYSTEM_EVENT_TASK_STACK_SIZE=4096
CONFIG_ESPTOOLPY_FLASHSIZE_4MB=y
CONFIG_PARTITION_TABLE_CUSTOM=y
CONFIG_PARTITION_TABLE_CUSTOM_FILENAME="partitions.csv"
CONFIG_FIRMWARE_URL="https://esp32-kopter.web.app/version.json"
```
